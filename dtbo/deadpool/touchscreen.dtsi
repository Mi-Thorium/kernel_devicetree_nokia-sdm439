&i2c_3 {
	status = "ok";

	gt9xx@5d {
		compatible = "goodix,gt9xx";
		reg = <0x5d>; 
		interrupt-parent = <&tlmm>;
		interrupts = <65 0x2008>;
		vdd_ana-supply = <&pm8953_l10>;
		vcc_i2c-supply = <&pm8953_l6>;
		#if 0
		pinctrl-names = "pmx_ts_active","pmx_ts_suspend","pmx_ts_release";
		pinctrl-0 = <&ts_int_active &ts_reset_active>;
		pinctrl-1 = <&ts_int_suspend &ts_reset_suspend>;
		pinctrl-2 = <&ts_release>;
		#endif
		pinctrl-names = "default", "int-output-low","int-output-high", "int-input";
		pinctrl-0 = <&ts_int_default>;
		pinctrl-1 = <&ts_int_output_low>;
		pinctrl-2 = <&ts_int_output_high>;
		pinctrl-3 = <&ts_int_input>;

		reset-gpios = <&tlmm 64 0x00>;
		irq-gpios = <&tlmm 65 0x2008>;
		irq-flags = <2>;
		touchscreen-max-id = <5>;
		touchscreen-size-x = <720>;
		touchscreen-size-y = <1520>;
		touchscreen-max-w = <1024>;
		touchscreen-max-p = <1024>;
		touchscreen-key-map = <172>, <158>; /*KEY_HOMEPAGE=172, KEY_BACK=158，KEY_MENU=139*/
		goodix,slide-wakeup = <0>;
		goodix,type-a-report = <0>;
		goodix,driver-send-cfg = <1>;
		goodix,resume-in-workqueue = <0>;
		goodix,int-sync = <1>;
		goodix,swap-x2y = <0>;
		goodix,esd-protect = <1>;
		goodix,auto-update-cfg = <1>;
		goodix,auto-update = <1>;
		goodix,power-off-sleep = <0>;
		goodix,pen-suppress-finger = <0>;
		goodix,cfg-group0 = [
			52 D0 02 F0 05 05 7D 08 22 AF 28 0F 50 32 03 03 00 00 00 00 08 01 08 28 26 2A 28 87 27 EE 46 48 D0 05 FF E4 00 03 32 11 00 00 00 00 00 00 40 00 00 00 42 32 5A 94 D0 52 07 00 00 04 A2 35 00 94 3B 00 84 43 00 78 4B 00 6D 55 00 6D 00 00 00 00 00 00 00 00 00 00 00 00 00 00 00 00 00 00 FF 67 00 00 0A 23 00 00 00 00 46 01 46 00 00 00 00 32 00 01 02 03 04 05 06 07 08 09 0A 0B 0C 0D 0E 0F 10 11 12 13 14 15 16 17 18 19 1A 1B FF FF 00 02 04 05 06 08 0A 1E 1F 20 22 24 29 2A FF FF FF 00 00 00 00 00 00 00 00 00 00 00 00 00 00 00 00 00 00 00 00 00 00 00 00 00 00 00 00 00 00 00 1E 3C 00 00 00 00 00 00 00 00 00 00 00 00 00 00 64 50 00 00 A0 00 80 0C 00 00 00 00 00 44 44 58 9A 4C 00 00 E6 01
		];
	};

	focaltech@38 {
		compatible = "focaltech,fts";
		reg = <0x38>;
		interrupt-parent = <&tlmm>;
		interrupts = <65 0x2800>;
		vdd-supply = <&pm8953_l10>;
		vcc_i2c-supply = <&pm8953_l6>;
		focaltech,reset-gpio = <&tlmm 64 0x00>;
		focaltech,irq-gpio = <&tlmm 65 0x2008>;
		focaltech,max-touch-number = <5>;
		focaltech,display-coords =  <0 0 720 1520>;
		pinctrl-names = "pmx_ts_active","pmx_ts_suspend","pmx_ts_release";
		pinctrl-0 = <&ts_int_active &ts_reset_active>;
		pinctrl-1 = <&ts_int_suspend &ts_reset_suspend>;
		pinctrl-2 = <&ts_release>;
		focaltech,have-key;
		focaltech,key-number = <3>;
		focaltech,keys = <158 139 172>;
		focaltech,key-y-coord = <2000>;
		focaltech,key-x-coords = <200 600 800>;
	};

	himax_ts@48 {
		compatible = "himax,hxcommon";
		reg = <0x48>;
		interrupt-parent = <&tlmm>;
		interrupts = <65 0x2800>;
		avdd-supply = <&pm8953_l10>;
		vdd-supply = <&pm8953_l6>;
		himax,rst-gpio = <&tlmm 64 0x00>;
		himax,irq-gpio = <&tlmm 65 0x2008>;
		himax,panel-coords = <0 720 0 1520>;
		himax,display-coords =  <0 720 0 1520>;
		pinctrl-names = "pmx_ts_active","pmx_ts_suspend","pmx_ts_release";
		pinctrl-0 = <&ts_int_active &ts_reset_active>;
		pinctrl-1 = <&ts_int_suspend &ts_reset_suspend>;
		pinctrl-2 = <&ts_release>;
		report_type = <1>;
	};
};
